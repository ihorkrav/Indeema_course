## components/MQTT_Utility/Kconfig.projbuild
```kconfig
menu "MQTT configuration"

    
    config EXAMPLE_MQTT_BROKER_URI
        string "MQTT broker URI"
        default "mqtts://test.mosquitto.org:8886"
        default "mqtts://test.mosquitto.org:8883" if EXAMPLE_CERT_VALIDATE_MOSQUITTO_CA
        help
            URI to the MQTT broker.
            When using the example broker the port must be set to 8883 if testing
            embedded certificate

    

endmenu
```
